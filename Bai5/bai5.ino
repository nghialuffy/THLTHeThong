
// 2-dimensional array of row pin numbers:
int R[] = {2,3,4,5,6,7,8,9};  
// 2-dimensional array of column pin numbers:
int C[] = {10,11,12,13,A2,A3,A4,A5};     
// Change C[3] = 1 because pin4 not good 
unsigned int BIT[8][8]={
    0,0,0,0,0,0,0,0,  
    0,0,0,0,0,0,0,0,  
    0,0,0,0,0,0,0,0,  
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    0,0,0,0,0,0,0,0,
};
unsigned int characterHEX[][8] = {
{0x18,0x3C,0x66,0x66,0x7E,0x66,0x66,0x66},//A
{0x78,0x64,0x68,0x78,0x64,0x66,0x66,0x7C},//B
{0x3C,0x62,0x60,0x60,0x60,0x62,0x62,0x3C},//C
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{0x00,0x00,0x00,0x00,0x00,0x00,0x00,0x00},// " "
};
char character[] = {'A','B','C','D','E','F','G','H','I','J','K','L','M','N','O','P','Q','R','S','T','U','V','W','X','Y','Z','0','1','2','3','4','5','6','7','8','9',' '};  
void setup()  
{  
  Serial.begin(9600);
   // iterate over the pins:
  for(int i = 0;i<8;i++)  
  // initialize the output pins:
  {  
    pinMode(R[i],OUTPUT);  
    pinMode(C[i],OUTPUT);  
  }  
  Serial.println("Nhap ten: ");
  
}  
  
void loop()  
{  
    String string = "LEVANNGHIA";
//  String string;// khai báo biến String object
//   /* đọc dữ liệu từ cổng Serial */
//   while(Serial.available() > 0)
//   {
//     char ch = Serial.read();
//     string += ch;// lưu ký tự vừa nhận được vào biến string
//     delay(5);// delay để đợi ký tự tiếp theo, KHÔNG THỂ THIẾU
//   }
   Serial.println(string);
  
  //ChuyenDoi(0);
  for (int i = 0; i<8; i++){
    for (int j =0; j<8; j++){
      Serial.print(BIT[i][j]);
    }
    Serial.println();
  }

   
   while(Serial.available() == 0)
   {
     for(int k = 0;k < string.length();k++)
     {
       for(int i=0;i < sizeof(character);i++)
       {
         if(string.charAt(k) == character[i])
         {
            ChuyenDoi(i);
            for (int z = 0; z < 100; z++){
              Display(BIT);
            }
            
            break;
         }
         if((i == (sizeof(character) - 1)) && (string.charAt(k) != character[i]))
         {
           Serial.print(string.charAt(k));
           Serial.println(":invalid character");
         }
       }
       /*kiểm tra xem có dữ liệu mới hay không*/
       if(Serial.available() > 0)
       break;
     }
     delay(300);
   }
}  
  
void Display(unsigned int dat[8][8])    
{  
  for(int c = 0; c<8;c++)  
  {  
    digitalWrite(C[c],HIGH);//use thr column 
    //loop
    for(int r = 0;r<8;r++)  
    {  
      digitalWrite(R[r],Dao(dat[r][c]));  
    }  
    delay(1);  
    Clear();  //Remove empty display light  
  } 
}  
int Dao(int x){
  if(x==1)
    x=0;
  else x=1;
  return x;
}
void ChuyenDoi(int x){
  int val;
    for (int i = 0 ; i <8 ; i++){
        val = characterHEX[x][i];
        for (int j = 7; j>=0; j--){
            BIT[i][j]=val%2;
            val/=2;
        }
    }
}
 
void Clear()                          
{  
  for(int i = 0;i<8;i++)  
  {  
    digitalWrite(R[i],HIGH); 
    digitalWrite(C[i],LOW);  
  }  
}  
